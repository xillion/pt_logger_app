## boards/custom/pt_logger_l433_v1/Kconfig.defconfig
```kconfig
if BOARD_PT_LOGGER_L433_V1

config BOARD
	default "pt_logger_l433_v1"

endif # BOARD_PT_LOGGER_L433_V1
```

## boards/custom/pt_logger_l433_v1/board.yml
```yaml
board:
  name: pt_logger_l433_v1
  full_name: PT_LOGGER_L433_V1
  vendor: custom
  socs:
    - name: stm32l433xx
```
